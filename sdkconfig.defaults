## sdkconfig.defaults
```kconfig
CONFIG_COMPILER_CXX_EXCEPTIONS=y
CONFIG_COMPILER_CXX_EXCEPTIONS_EMG_POOL_SIZE=1024

CONFIG_BOOTLOADER_COMPILER_OPTIMIZATION_PERF=y
CONFIG_BOOTLOADER_LOG_LEVEL_NONE=y
CONFIG_BOOTLOADER_SKIP_VALIDATE_ALWAYS=y
CONFIG_BOOTLOADER_APP_ROLLBACK_ENABLE=y

CONFIG_HTTPD_MAX_REQ_HDR_LEN=2048
CONFIG_HTTPD_MAX_URI_LEN=2048

CONFIG_PARTITION_TABLE_CUSTOM=y
CONFIG_PARTITION_TABLE_CUSTOM_FILENAME="partitions/v1/16m.csv"
CONFIG_PARTITION_TABLE_OFFSET=0x8000

CONFIG_ESP_TASK_WDT_TIMEOUT_S=10
CONFIG_FREERTOS_GENERATE_RUN_TIME_STATS=y
CONFIG_FREERTOS_USE_STATS_FORMATTING_FUNCTIONS=y

# Main task stack size - reduce main task stack
CONFIG_ESP_MAIN_TASK_STACK_SIZE=8192
# System event task stack size optimization
CONFIG_ESP_SYSTEM_EVENT_TASK_STACK_SIZE=2048
# Timer task stack size optimization
CONFIG_FREERTOS_TIMER_TASK_STACK_DEPTH=1024
CONFIG_MBEDTLS_DYNAMIC_BUFFER=y
CONFIG_MBEDTLS_SSL_KEEP_PEER_CERTIFICATE=n
# Enable DHM for BluFi security
CONFIG_MBEDTLS_DHM_C=y
CONFIG_ESP_WIFI_IRAM_OPT=n
CONFIG_ESP_WIFI_RX_IRAM_OPT=n
CONFIG_ESP_WIFI_DYNAMIC_RX_MGMT_BUFFER=y

# These entries are copied from ESP-HI (ESP32C3) to reduce memory usage
CONFIG_ESP_WIFI_STATIC_RX_BUFFER_NUM=6
CONFIG_ESP_WIFI_DYNAMIC_RX_BUFFER_NUM=8
CONFIG_NEWLIB_NANO_FORMAT=y
CONFIG_ESP_WIFI_ENTERPRISE_SUPPORT=n

# WiFi Configuration - further optimize memory usage
CONFIG_ESP32_WIFI_STATIC_RX_BUFFER_NUM=2
CONFIG_ESP32_WIFI_DYNAMIC_RX_BUFFER_NUM=4
CONFIG_ESP32_WIFI_TX_BUFFER_TYPE=0
CONFIG_ESP32_WIFI_STATIC_TX_BUFFER_NUM=2
CONFIG_ESP32_WIFI_DYNAMIC_TX_BUFFER_NUM=6
CONFIG_ESP32_WIFI_CSI_ENABLED=n
CONFIG_ESP32_WIFI_AMPDU_TX_ENABLED=n
CONFIG_ESP32_WIFI_AMPDU_RX_ENABLED=n
CONFIG_ESP32_WIFI_AMSDU_TX_ENABLED=n
CONFIG_ESP32_WIFI_NVS_ENABLED=y
# Reduce WiFi task stack size
CONFIG_ESP32_WIFI_TASK_STACK_SIZE=2048
# Disable WiFi debug to save memory
CONFIG_ESP32_WIFI_DEBUG_LOG_ENABLE=n

CONFIG_CODEC_I2C_BACKWARD_COMPATIBLE=n

# Bluetooth memory optimization configuration
CONFIG_BT_ENABLED=y
CONFIG_BT_BLE_ENABLED=y
CONFIG_BT_BLUFI_ENABLED=y
CONFIG_BT_ALLOCATION_FROM_SPIRAM_FIRST=y
CONFIG_BT_BLE_DYNAMIC_ENV_MEMORY=y
CONFIG_BTDM_CTRL_MODE_BLE_ONLY=y
CONFIG_BT_ACL_CONNECTIONS=1
CONFIG_BT_GATT_MAX_SR_PROFILES=4
CONFIG_BT_GATT_MAX_SR_ATTRIBUTES=20
CONFIG_BT_BTC_TASK_STACK_SIZE=4096
CONFIG_BT_BTU_TASK_STACK_SIZE=4096
CONFIG_BT_MAX_DEVICE_NAME_LEN=32
CONFIG_BT_SMP_MAX_BONDS=1

# LVGL component optimization - enable only necessary components
CONFIG_LVGL_USE_LABEL=y
CONFIG_LVGL_USE_BTN=y
CONFIG_LVGL_USE_IMG=y
CONFIG_LVGL_USE_SLIDER=y
CONFIG_LVGL_USE_ARC=y
CONFIG_LVGL_USE_SPINNER=y
CONFIG_LVGL_USE_TEXTAREA=y
CONFIG_LVGL_USE_KEYBOARD=y
# Disable uncommon LVGL components to save memory
# CONFIG_LVGL_USE_DROPDOWN=n
# CONFIG_LVGL_USE_ROLLER=n
# CONFIG_LVGL_USE_TABVIEW=n
# CONFIG_LVGL_USE_TILEVIEW=n
# CONFIG_LVGL_USE_WIN=n
# CONFIG_LVGL_USE_MSGBOX=n
# CONFIG_LVGL_USE_MENU=n
# CONFIG_LVGL_USE_CHART=n
# CONFIG_LVGL_USE_TABLE=n
# CONFIG_LVGL_USE_LED=n
# CONFIG_LVGL_USE_BAR=n
# CONFIG_LVGL_USE_SWITCH=n
# CONFIG_LVGL_USE_CHECKBOX=n
# CONFIG_LVGL_USE_LIST=n
# CONFIG_LVGL_USE_CALENDAR=n
# CONFIG_LVGL_USE_COLORWHEEL=n
# CONFIG_LVGL_USE_IMGBTN=n
# CONFIG_LVGL_USE_SPAN=n
# CONFIG_LVGL_USE_METER=n
# CONFIG_LVGL_USE_ANIMIMG=n
# CONFIG_LVGL_USE_CANVAS=n
# CONFIG_LVGL_USE_LINE=n

# Fix ML307 FIFO Overflow
CONFIG_UART_ISR_IN_IRAM=y

# LVGL 9.2.2

CONFIG_LV_OS_NONE=y
CONFIG_LV_USE_OS=0
CONFIG_LV_USE_CLIB_MALLOC=y
CONFIG_LV_USE_CLIB_STRING=y
CONFIG_LV_USE_CLIB_SPRINTF=y
CONFIG_LV_USE_IMGFONT=y

# Use compressed font
CONFIG_LV_FONT_FMT_TXT_LARGE=y
CONFIG_LV_USE_FONT_COMPRESSED=y
CONFIG_LV_USE_FONT_PLACEHOLDER=y

# Disable extra widgets to save flash size
CONFIG_LV_USE_ANIMIMG=n
CONFIG_LV_USE_CALENDAR=n
CONFIG_LV_USE_CALENDAR_HEADER_ARROW=n
CONFIG_LV_USE_CALENDAR_HEADER_DROPDOWN=n
CONFIG_LV_USE_CHART=n
CONFIG_LV_USE_KEYBOARD=n
CONFIG_LV_USE_LED=n
CONFIG_LV_USE_LIST=n
CONFIG_LV_USE_MENU=n
CONFIG_LV_USE_MSGBOX=n
CONFIG_LV_USE_SPAN=n
CONFIG_LV_USE_SPINBOX=n
CONFIG_LV_USE_SPINNER=n
CONFIG_LV_USE_TABVIEW=n
CONFIG_LV_USE_TILEVIEW=n
CONFIG_LV_USE_WIN=n

CONFIG_LV_BUILD_EXAMPLES=n
```
